fragment@1 {
	target = <&ecspi4>;
	__overlay__ {
		status = "okay";
		#address-cells = <1>;
		#size-cells = <0>;

		unipispi22: unipispi@2 {
			compatible = "unipispi";
			reg = <2>;
			status = "okay";
			spi-max-frequency = <12000000>;
			modbus-address = <22>;
		};
	};
};
