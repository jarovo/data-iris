/dts-v1/;

/plugin/;

/ {

fragment@0 {
	target = <&i2c3>;
	__overlay__ {
		#address-cells = <1>;
		#size-cells = <0>;
		unipiid_12: ee_slot@40000001 {
			compatible = "unipi,unipi-id";
			reg = <0x40000001>;
		};
/*			#address-cells = <1>;
			#size-cells = <1>;
			unipi_banks: unipidata@0 {
				reg = <0x0 0x100>;
			};
*/
	};
};
};