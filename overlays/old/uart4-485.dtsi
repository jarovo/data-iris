	fragment@3 {
		target = <&uart4>;
		__overlay__ {
			pinctrl-names = "default";
			pinctrl-0 = <&pinctrl_uart4>, <&pinctrl_uart4_ctrl>;
			status = "okay";
			//ToDo: rts-gpios = <&gpio4 29 0>;
			linux,rs485-enabled-at-boot-time;
		};
	};
