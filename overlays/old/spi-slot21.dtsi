fragment@1 {
	target = <&ecspi2>;
	__overlay__ {
		status = "okay";
		#address-cells = <1>;
		#size-cells = <0>;

		unipispi21: unipispi@1 {
			compatible = "unipispi";
			reg = <1>;
			status = "okay";
			spi-max-frequency = <12000000>;
			modbus-address = <21>;
		};
	};
};
